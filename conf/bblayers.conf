## conf/bblayers.conf
```bitbake
# POKY_BBLAYERS_CONF_VERSION is increased each time build/conf/bblayers.conf
# changes incompatibly
POKY_BBLAYERS_CONF_VERSION = "2"

BBPATH = "${TOPDIR}"
BBFILES ?= ""

BBLAYERS ?= " \
  /home/mahadev/github/openbmc/poky/meta \
  /home/mahadev/github/openbmc/poky/meta-poky \
  /home/mahadev/github/openbmc/poky/meta-yocto-bsp \
  /home/mahadev/github/openbmc/meta-raspberrypi \
  "
```
